## conf/layer.conf
```bitbake
# SPDX-FileCopyrightText: Copyright (c) 2026 Jason Perlow
# SPDX-License-Identifier: Apache-2.0
#
# meta-nclawzero-base — Yocto layer producing flashable minimal
# Linux images for Raspberry Pi and Jetson Orin Nano. Includes
# optional recipes for the ZeroClaw and NemoClaw AI agent
# runtimes, layered as opt-in packagegroups so the base image
# stays agent-free.

BBPATH .= ":${LAYERDIR}"

BBFILES += " \
    ${LAYERDIR}/recipes-*/*/*.bb \
    ${LAYERDIR}/recipes-*/*/*.bbappend \
"

BBFILE_COLLECTIONS += "nclawzero-base"
BBFILE_PATTERN_nclawzero-base = "^${LAYERDIR}/"
BBFILE_PRIORITY_nclawzero-base = "10"

LAYERDEPENDS_nclawzero-base = " \
    core \
    meta-python \
    openembedded-layer \
"

LAYERSERIES_COMPAT_nclawzero-base = "scarthgap"
```
